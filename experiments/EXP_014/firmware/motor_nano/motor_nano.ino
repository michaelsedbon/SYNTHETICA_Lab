/*
 * EXP_014 — Motor Controller Firmware
 * ====================================
 * AccelStepper motor control + proximity sensor + serial command interface.
 * Based on EXP_011 Step 5+6, updated for EXP_014 machine controller.
 *
 * Serial commands (115200 baud, newline-terminated):
 *   PING            → PONG
 *   IDENTIFY        → MOTOR_1 (compile-time device ID)
 *   STATUS          → POS:x SPEED:x MOVING:x TARGET:x SENSOR:x
 *   MOVE <steps>    → relative move
 *   MOVETO <pos>    → absolute move
 *   HOME            → move until sensor triggers, then zero position
 *   STOP            → emergency stop
 *   SPEED <sps>     → set max speed
 *   ACCEL <val>     → set acceleration
 *   ZERO            → reset position to 0
 *
 * Pins: D4 = STEP (PUL+), D2 = DIR (DIR+), D3 = Proximity sensor
 */

#include <Arduino.h>
#include <AccelStepper.h>
#include "config.h"               // generated by build.py from motor_configs.yaml

// ── Configuration constants from config.h ──
// build.py turns each `motor_configs.yaml` entry into a header containing:
//   DEVICE_ID, PIN_STEP, PIN_DIR, PIN_SENSOR, HOME_DIR, DEFAULT_MAX_STEPS,
//   CAL_SPEED_DOWN, CAL_SPEED_UP, CAL_CHUNK_STEPS, CAL_PAUSE_MS,
//   DEFAULT_SPEED, DEFAULT_ACCEL.
// To reflash a different motor: edit motor_configs.yaml, run `build.py <ID>`.

#define HOME_SPEED 800.0          // sps — speed used by the HOME command (shared)

AccelStepper stepper(AccelStepper::DRIVER, PIN_STEP, PIN_DIR);
String inputBuffer = "";

// State machine — replaces the old `homing` flag.
enum MotorMode {
    MODE_IDLE,           // normal — accept move commands
    MODE_HOMING,         // HOME command in progress (down to sensor, then idle)
    MODE_CAL_DOWN,       // CALIBRATE phase 1 — chunked downward search
    MODE_CAL_PAUSE,      // CALIBRATE phase 2 — sitting at sensor for CAL_PAUSE_MS
    MODE_CAL_UP,         // CALIBRATE phase 3 — moving up to max_steps
    MODE_CAL_PAUSE_TOP,  // CALIBRATE phase 4 — pause at top for CAL_PAUSE_MS
    MODE_CAL_CENTER      // CALIBRATE phase 5 — moving to maxStepCount/2 (rest pos)
};
MotorMode motorMode = MODE_IDLE;

long maxStepCount = DEFAULT_MAX_STEPS;  // current calibrated travel limit
long calDownIssuedSteps = 0;            // running total of negative steps issued in CAL_DOWN
unsigned long calPauseStartMs = 0;      // millis() when CAL_PAUSE began
bool IS_CALIBRATED = false;             // true only after a CAL_DONE; reset on boot or abort
float currentAccel = DEFAULT_ACCEL;     // mirror of stepper's acceleration (no public getter on AccelStepper)

// Sensor edge-event state (driven by INT1 on D3, set in ISR, cleared in loop()).
volatile bool sensorChanged = true;   // true on boot so we emit the initial state
volatile bool limitTripped = false;   // ISR raises this on a falling edge (sensor active)
int lastEmittedSensor = -1;

const char* modeName(MotorMode m) {
    switch (m) {
        case MODE_IDLE:           return "idle";
        case MODE_HOMING:         return "homing";
        case MODE_CAL_DOWN:       return "cal_down";
        case MODE_CAL_PAUSE:      return "cal_pause";
        case MODE_CAL_UP:         return "cal_up";
        case MODE_CAL_PAUSE_TOP:  return "cal_pause_top";
        case MODE_CAL_CENTER:     return "cal_center";
    }
    return "?";
}

// Software clamp — refuse moves beyond [0, maxStepCount].
//   • Top bound (maxStepCount) is ALWAYS enforced — there is no upper limit
//     switch and exceeding maxStepCount will crash the carriage into the rail.
//   • Bottom bound (0) is enforced only after IS_CALIBRATED, since before
//     calibration "0" is whatever step count happened to be at boot.
// Returns the clamped target. Out-param `wasClamped` flags whether clamping
// actually happened (so the caller can warn).
long clampTarget(long pos, bool& wasClamped) {
    wasClamped = false;
    if (pos > maxStepCount) { wasClamped = true; return maxStepCount; }
    if (IS_CALIBRATED && pos < 0) { wasClamped = true; return 0; }
    return pos;
}

int readSensor() {
    return digitalRead(PIN_SENSOR) == LOW ? 1 : 0;  // NPN NO: LOW when triggered
}

// ISR — fires on every edge of the sensor pin (INT1 / D3).
// Keeps work to a minimum: raises a flag for the main loop to emit an event,
// and a second flag for the safety stop if the sensor went active (LOW).
void sensorISR() {
    sensorChanged = true;
    if (digitalRead(PIN_SENSOR) == LOW) {
        limitTripped = true;
    }
}

void processCommand(String cmd) {
    cmd.trim();
    cmd.toUpperCase();
    if (cmd.length() == 0) return;

    if (cmd == "PING") {
        Serial.println("PONG");
        return;
    }

    if (cmd == "IDENTIFY") {
        Serial.print(DEVICE_ID);
#ifdef DEVICE_DESCRIPTION
        Serial.print(" — ");
        Serial.print(DEVICE_DESCRIPTION);
#endif
        Serial.println();
        return;
    }

    if (cmd == "STATUS") {
        Serial.print("POS:"); Serial.print(stepper.currentPosition());
        Serial.print(" SPEED:"); Serial.print((int)stepper.maxSpeed());
        Serial.print(" ACCEL:"); Serial.print((int)currentAccel);
        Serial.print(" MOVING:"); Serial.print(stepper.isRunning() ? 1 : 0);
        Serial.print(" TARGET:"); Serial.print(stepper.targetPosition());
        Serial.print(" SENSOR:"); Serial.print(readSensor());
        Serial.print(" MAX:"); Serial.print(maxStepCount);
        Serial.print(" CAL:"); Serial.print(IS_CALIBRATED ? 1 : 0);
        Serial.print(" CAL_EN:"); Serial.print(CAL_ENABLED ? 1 : 0);
        Serial.print(" MODE:"); Serial.println(modeName(motorMode));
        return;
    }

    if (cmd == "STOP") {
        // Aborting from any active calibration sub-state invalidates calibration.
        if (motorMode == MODE_CAL_DOWN || motorMode == MODE_CAL_PAUSE ||
            motorMode == MODE_CAL_UP   || motorMode == MODE_CAL_PAUSE_TOP ||
            motorMode == MODE_CAL_CENTER) {
            IS_CALIBRATED = false;
        }
        motorMode = MODE_IDLE;
        stepper.stop();
        stepper.setCurrentPosition(stepper.currentPosition());  // force stop
        stepper.setMaxSpeed(DEFAULT_SPEED);                     // restore default speed
        Serial.println("OK STOPPED");
        return;
    }

    if (cmd.startsWith("MOVE ")) {
        long steps = cmd.substring(5).toInt();
        long requested = stepper.currentPosition() + steps;
        bool clamped = false;
        long target = clampTarget(requested, clamped);
        long actual_steps = target - stepper.currentPosition();
        stepper.move(actual_steps);
        if (clamped) {
            Serial.print("OK MOVE "); Serial.print(actual_steps);
            Serial.print(" (clamped target "); Serial.print(requested);
            Serial.print(" -> "); Serial.print(target); Serial.println(")");
        } else {
            Serial.print("OK MOVE "); Serial.println(actual_steps);
        }
        return;
    }

    if (cmd.startsWith("MOVETO ")) {
        long pos = cmd.substring(7).toInt();
        bool clamped = false;
        long target = clampTarget(pos, clamped);
        stepper.moveTo(target);
        if (clamped) {
            Serial.print("OK MOVETO "); Serial.print(target);
            Serial.print(" (clamped from "); Serial.print(pos); Serial.println(")");
        } else {
            Serial.print("OK MOVETO "); Serial.println(target);
        }
        return;
    }

    if (cmd == "HOME") {
        if (readSensor()) {
            // Already at home, just zero
            stepper.setCurrentPosition(0);
            Serial.println("OK HOME (already at sensor)");
        } else {
            motorMode = MODE_HOMING;
            stepper.setMaxSpeed(HOME_SPEED);
            // Bounded search (2× maxStepCount) so a missing sensor can't run
            // the motor forever. The emergency-stop ISR catches the trip well
            // before this bound is hit.
            stepper.move(HOME_DIR * (maxStepCount * 2));
            Serial.println("OK HOMING");
        }
        return;
    }

    // CALIBRATE — chunked down-search, 2 s pause at sensor, then climb to max.
    // Aliases: "CAL ON" (start), "CAL OFF" (abort).
    if (cmd == "CALIBRATE" || cmd == "CAL ON") {
        if (!CAL_ENABLED) {
            // Per-motor switch (compile-time, from motor_configs.yaml).
            // Used to ship a motor with calibration disabled until the user
            // has hand-validated the mechanical setup.
            Serial.println("ERROR:CAL_DISABLED — calibration disabled in firmware config");
            return;
        }
        if (motorMode != MODE_IDLE) {
            Serial.print("ERROR:CAL_BUSY mode="); Serial.println(modeName(motorMode));
            return;
        }
        IS_CALIBRATED = false;          // calibration in progress — old result invalidated
        if (readSensor()) {
            // Already at the sensor — skip the down phase, jump to the pause.
            stepper.setCurrentPosition(0);
            calPauseStartMs = millis();
            motorMode = MODE_CAL_PAUSE;
            Serial.println("OK CAL_PAUSE (already at sensor)");
        } else {
            calDownIssuedSteps = 0;
            stepper.setMaxSpeed(CAL_SPEED_DOWN);
            stepper.move(HOME_DIR * CAL_CHUNK_STEPS);
            calDownIssuedSteps += CAL_CHUNK_STEPS;
            motorMode = MODE_CAL_DOWN;
            Serial.print("OK CAL_DOWN chunk=");
            Serial.print(CAL_CHUNK_STEPS);
            Serial.println(" (unbounded search — STOP to abort)");
        }
        return;
    }

    if (cmd == "CAL OFF") {
        IS_CALIBRATED = false;
        motorMode = MODE_IDLE;
        stepper.stop();
        stepper.setMaxSpeed(DEFAULT_SPEED);
        Serial.println("OK CAL_OFF");
        return;
    }

    if (cmd.startsWith("MAXSTEPS ")) {
        long n = cmd.substring(9).toInt();
        if (n > 0 && n <= 1000000L) {
            maxStepCount = n;
            Serial.print("OK MAXSTEPS "); Serial.println(maxStepCount);
        } else {
            Serial.println("ERROR:INVALID_MAXSTEPS");
        }
        return;
    }
    if (cmd == "MAXSTEPS") {
        // Query form
        Serial.print("MAXSTEPS:"); Serial.println(maxStepCount);
        return;
    }

    if (cmd == "ZERO") {
        stepper.setCurrentPosition(0);
        Serial.println("OK ZERO");
        return;
    }

    if (cmd.startsWith("SPEED ")) {
        float spd = cmd.substring(6).toFloat();
        stepper.setMaxSpeed(spd);
        Serial.print("OK SPEED "); Serial.println((int)spd);
        return;
    }

    if (cmd.startsWith("ACCEL ")) {
        float a = cmd.substring(6).toFloat();
        stepper.setAcceleration(a);
        currentAccel = a;
        Serial.print("OK ACCEL "); Serial.println((int)a);
        return;
    }

    Serial.print("ERROR:UNKNOWN:"); Serial.println(cmd);
}

void setup() {
    Serial.begin(115200);

    // Motor setup — defaults sourced from config.h (motor_configs.yaml)
    stepper.setMaxSpeed(DEFAULT_SPEED);
    stepper.setAcceleration(DEFAULT_ACCEL);
    stepper.setMinPulseWidth(20);
    pinMode(PIN_STEP, OUTPUT);
    pinMode(PIN_DIR, OUTPUT);

    // Sensor setup — D3 = external interrupt INT1 on ATmega328P.
    // CHANGE fires on both rising and falling edges so we catch trigger AND release.
    pinMode(PIN_SENSOR, INPUT_PULLUP);
    attachInterrupt(digitalPinToInterrupt(PIN_SENSOR), sensorISR, CHANGE);

    // Alive blink
    pinMode(LED_BUILTIN, OUTPUT);
    for (int i = 0; i < 3; i++) {
        digitalWrite(LED_BUILTIN, HIGH); delay(100);
        digitalWrite(LED_BUILTIN, LOW); delay(100);
    }

    Serial.print("READY ");
    Serial.print(DEVICE_ID);
#ifdef DEVICE_DESCRIPTION
    Serial.print(" — ");
    Serial.print(DEVICE_DESCRIPTION);
#endif
    Serial.print(" cal_en=");
    Serial.println(CAL_ENABLED ? 1 : 0);
}

void loop() {
    // ── Emergency limit stop ──────────────────────────────────────────────
    // ISR sets limitTripped on the falling edge of the sensor (active LOW).
    // We honour it here, *before* stepper.run(), so the motor never takes
    // another step downward after the trip: if the carriage is moving
    // toward the sensor (distanceToGo < 0), kill the motion immediately.
    // Moves AWAY from the sensor are allowed — that's how CAL_UP escapes.
    if (limitTripped) {
        limitTripped = false;
        if (stepper.distanceToGo() < 0) {
            stepper.setAcceleration(100000.0);            // crash-stop hint
            stepper.moveTo(stepper.currentPosition());    // discard pending motion
            stepper.setAcceleration(currentAccel);        // restore the user-set accel (not the boot default)
            // State-specific reaction is handled by the mode block below.
        }
    }

    stepper.run();

    // Sensor edge events for the dashboard. The proximity sensor is electronic
    // (no mechanical bounce), so re-reading the pin gives the settled state.
    if (sensorChanged) {
        sensorChanged = false;
        int current = readSensor();
        if (current != lastEmittedSensor) {
            lastEmittedSensor = current;
            Serial.print("EVENT SENSOR:");
            Serial.println(current);
        }
    }

    // ── State machine ─────────────────────────────────────────────────────
    if (motorMode == MODE_HOMING) {
        if (readSensor()) {
            motorMode = MODE_IDLE;
            stepper.moveTo(stepper.currentPosition());
            stepper.setCurrentPosition(0);
            stepper.setMaxSpeed(DEFAULT_SPEED);
            Serial.println("HOME_DONE POS:0");
        } else if (!stepper.isRunning()) {
            motorMode = MODE_IDLE;
            stepper.setMaxSpeed(DEFAULT_SPEED);
            Serial.println("ERROR:HOME_NO_SENSOR");
        }
    } else if (motorMode == MODE_CAL_DOWN) {
        // Sensor reached — either mid-chunk via the safety stop above, or at
        // the boundary of a chunk. Either way, we're stopped on the trip.
        if (readSensor()) {
            stepper.moveTo(stepper.currentPosition());    // ensure stopped
            stepper.setCurrentPosition(0);                // zero here
            calPauseStartMs = millis();
            motorMode = MODE_CAL_PAUSE;
            Serial.println("EVENT CAL_DOWN_DONE POS:0 — pausing 2s");
        } else if (!stepper.isRunning()) {
            // Chunk completed without a trip — issue another chunk. The down
            // search is intentionally UNBOUNDED: it keeps stepping toward the
            // sensor until either (a) the limit is tripped (handled in the
            // branch above + the emergency-stop ISR), or (b) the operator
            // sends STOP / CAL OFF. This was a deliberate choice — the
            // search-bound abort was removing the run before the trip plate
            // ever reached the sensor.
            stepper.move(HOME_DIR * CAL_CHUNK_STEPS);
            calDownIssuedSteps += CAL_CHUNK_STEPS;
            Serial.print("EVENT CAL_CHUNK total=");
            Serial.println(calDownIssuedSteps);
        }
    } else if (motorMode == MODE_CAL_PAUSE) {
        // Hold still for CAL_PAUSE_MS, then start the upward climb.
        if (millis() - calPauseStartMs >= CAL_PAUSE_MS) {
            stepper.setMaxSpeed(CAL_SPEED_UP);
            stepper.moveTo(maxStepCount);
            motorMode = MODE_CAL_UP;
            Serial.print("EVENT CAL_PAUSE_DONE — moving up to ");
            Serial.println(maxStepCount);
        }
    } else if (motorMode == MODE_CAL_UP) {
        if (!stepper.isRunning()) {
            // Reached the top — pause for CAL_PAUSE_MS before going to mid.
            calPauseStartMs = millis();
            motorMode = MODE_CAL_PAUSE_TOP;
            Serial.print("EVENT CAL_UP_DONE POS:");
            Serial.println(stepper.currentPosition());
        }
    } else if (motorMode == MODE_CAL_PAUSE_TOP) {
        if (millis() - calPauseStartMs >= CAL_PAUSE_MS) {
            long mid = maxStepCount / 2;
            stepper.setMaxSpeed(CAL_SPEED_UP);
            stepper.moveTo(mid);
            motorMode = MODE_CAL_CENTER;
            Serial.print("EVENT CAL_TOP_PAUSE_DONE — moving to mid ");
            Serial.println(mid);
        }
    } else if (motorMode == MODE_CAL_CENTER) {
        if (!stepper.isRunning()) {
            motorMode = MODE_IDLE;
            stepper.setMaxSpeed(DEFAULT_SPEED);
            IS_CALIBRATED = true;       // success — flag is set here and only here
            Serial.print("EVENT CAL_DONE POS:");
            Serial.print(stepper.currentPosition());
            Serial.println(" CAL:1");
        }
    }

    // Serial command processing
    while (Serial.available()) {
        char c = Serial.read();
        if (c == '\n') {
            processCommand(inputBuffer);
            inputBuffer = "";
        } else if (c != '\r') {
            inputBuffer += c;
        }
        stepper.run();
    }
}
